/**
 * @cliArgs --board "/ti/boards/LP_MSPM0G3507" --product "mspm0_sdk@2.00.00.03"
 * @versions {"tool":"1.19.0+3426"}
 */

/**
 * Import the modules used in this configuration.
 */
const GPIO          = scripting.addModule("/ti/driverlib/GPIO", {}, false);
const GPIO1         = GPIO.addInstance();
const GPIO2         = GPIO.addInstance();
const GPIO3         = GPIO.addInstance();
const GPIO4         = GPIO.addInstance();
const GPIO5         = GPIO.addInstance();
const GPIO6         = GPIO.addInstance();
const I2C           = scripting.addModule("/ti/driverlib/I2C", {}, false);
const I2C1          = I2C.addInstance();
const I2C2          = I2C.addInstance();
const SPI           = scripting.addModule("/ti/driverlib/SPI", {}, false);
const SPI1          = SPI.addInstance();
const SYSCTL        = scripting.addModule("/ti/driverlib/SYSCTL");
const TIMER         = scripting.addModule("/ti/driverlib/TIMER", {}, false);
const TIMER1        = TIMER.addInstance();
const TIMER2        = TIMER.addInstance();
const TIMER3        = TIMER.addInstance();
const UART          = scripting.addModule("/ti/driverlib/UART", {}, false);
const UART1         = UART.addInstance();
const UART2         = UART.addInstance();
const ProjectConfig = scripting.addModule("/ti/project_config/ProjectConfig");

/**
 * Write custom configuration values to the imported modules.
 */
GPIO1.$name                         = "USB_";
GPIO1.associatedPins.create(7);
GPIO1.associatedPins[0].$name       = "ENA";
GPIO1.associatedPins[0].pin.$assign = "j17_expansion.1";
GPIO1.associatedPins[1].$name       = "ENB";
GPIO1.associatedPins[1].pin.$assign = "j17_expansion.2";
GPIO1.associatedPins[2].$name       = "SEL_A0";
GPIO1.associatedPins[2].pin.$assign = "j17_expansion.3";
GPIO1.associatedPins[3].$name       = "SEL_A1";
GPIO1.associatedPins[3].pin.$assign = "j17_expansion.4";
GPIO1.associatedPins[4].$name       = "SEL_B0";
GPIO1.associatedPins[4].pin.$assign = "boosterpack.3";
GPIO1.associatedPins[5].$name       = "SEL_B1";
GPIO1.associatedPins[5].pin.$assign = "boosterpack.13";
GPIO1.associatedPins[6].$name       = "VBUS_ON";
GPIO1.associatedPins[6].pin.$assign = "boosterpack.17";

const Board                       = scripting.addModule("/ti/driverlib/Board", {}, false);
Board.peripheral.$assign          = "DEBUGSS";
Board.peripheral.swclkPin.$assign = "j25_expansion.16";
Board.peripheral.swdioPin.$assign = "j25_expansion.14";

GPIO2.$name                         = "UART";
GPIO2.associatedPins.create(3);
GPIO2.associatedPins[0].$name       = "Select_A0";
GPIO2.associatedPins[0].pin.$assign = "boosterpack.7";
GPIO2.associatedPins[1].$name       = "En";
GPIO2.associatedPins[1].pin.$assign = "boosterpack.15";
GPIO2.associatedPins[2].$name       = "Select_A1";
GPIO2.associatedPins[2].pin.$assign = "j17_expansion.9";

GPIO3.$name                         = "GPIO_GRP_0";
GPIO3.associatedPins[0].$name       = "PIN_0";
GPIO3.associatedPins[0].pin.$assign = "j19_expansion.9";

GPIO4.$name                          = "ADC";
GPIO4.associatedPins.create(3);
GPIO4.associatedPins[0].$name        = "SPI_CS";
GPIO4.associatedPins[0].initialValue = "SET";
GPIO4.associatedPins[0].pin.$assign  = "boosterpack.36";
GPIO4.associatedPins[1].$name        = "nERROR";
GPIO4.associatedPins[1].initialValue = "SET";
GPIO4.associatedPins[1].pin.$assign  = "boosterpack.24";
GPIO4.associatedPins[2].$name        = "nSYNC";
GPIO4.associatedPins[2].initialValue = "SET";
GPIO4.associatedPins[2].pin.$assign  = "j17_expansion.8";

GPIO5.$name                         = "LED";
GPIO5.associatedPins[0].$name       = "Green";
GPIO5.associatedPins[0].pin.$assign = "j17_expansion.7";
scripting.suppress("Connected to hardware,@@@.+?@@@ is connected to XDS110 UART on the MSPM0G3507 LaunchPad\\. Consider selecting it in 'use hardware' above\\. @@@.+?@@@", GPIO5.associatedPins[0], "pin");

GPIO6.$name                               = "LED_";
GPIO6.associatedPins.create(3);
GPIO6.associatedPins[0].$name             = "GREEN";
GPIO6.associatedPins[0].launchPadShortcut = "LED2GreenEn";
GPIO6.associatedPins[1].launchPadShortcut = "LED2RedEn";
GPIO6.associatedPins[1].$name             = "RED";
GPIO6.associatedPins[2].$name             = "BLUE";
GPIO6.associatedPins[2].launchPadShortcut = "LED2BlueEn";

I2C1.$name                             = "Daughter_I2C";
I2C1.basicEnableController             = true;
I2C1.intController                     = ["ARBITRATION_LOST","EVENT1_DMA_DONE","EVENT2_DMA_DONE","NACK","RXFIFO_FULL","RXFIFO_TRIGGER","RX_DONE","START","STOP","TXFIFO_EMPTY","TXFIFO_TRIGGER","TX_DONE"];
I2C1.peripheral.$assign                = "I2C0";
I2C1.peripheral.sdaPin.$assign         = "boosterpack.38";
I2C1.peripheral.sclPin.$assign         = "boosterpack.37";
I2C1.sdaPinConfig.hideOutputInversion  = scripting.forceWrite(false);
I2C1.sdaPinConfig.onlyInternalResistor = scripting.forceWrite(false);
I2C1.sdaPinConfig.passedPeripheralType = scripting.forceWrite("Digital");
I2C1.sdaPinConfig.$name                = "ti_driverlib_gpio_GPIOPinGeneric2";
I2C1.sclPinConfig.hideOutputInversion  = scripting.forceWrite(false);
I2C1.sclPinConfig.onlyInternalResistor = scripting.forceWrite(false);
I2C1.sclPinConfig.passedPeripheralType = scripting.forceWrite("Digital");
I2C1.sclPinConfig.$name                = "ti_driverlib_gpio_GPIOPinGeneric3";

I2C2.$name                             = "Master_I2C";
I2C2.basicEnableController             = true;
I2C2.intController                     = ["ARBITRATION_LOST","EVENT1_DMA_DONE","EVENT2_DMA_DONE","NACK","RXFIFO_FULL","RXFIFO_TRIGGER","RX_DONE","START","STOP","TXFIFO_EMPTY","TXFIFO_TRIGGER","TX_DONE"];
I2C2.peripheral.$assign                = "I2C1";
I2C2.peripheral.sdaPin.$assign         = "boosterpack.10";
I2C2.peripheral.sclPin.$assign         = "boosterpack.9";
I2C2.sdaPinConfig.hideOutputInversion  = scripting.forceWrite(false);
I2C2.sdaPinConfig.onlyInternalResistor = scripting.forceWrite(false);
I2C2.sdaPinConfig.passedPeripheralType = scripting.forceWrite("Digital");
I2C2.sdaPinConfig.$name                = "ti_driverlib_gpio_GPIOPinGeneric4";
I2C2.sclPinConfig.hideOutputInversion  = scripting.forceWrite(false);
I2C2.sclPinConfig.onlyInternalResistor = scripting.forceWrite(false);
I2C2.sclPinConfig.passedPeripheralType = scripting.forceWrite("Digital");
I2C2.sclPinConfig.$name                = "ti_driverlib_gpio_GPIOPinGeneric5";

SPI1.$name                      = "SPI_0";
SPI1.enabledInterrupts          = ["IDLE","RX","TX"];
SPI1.overrideRetention          = true;
SPI1.polarity                   = "1";
SPI1.phase                      = "1";
SPI1.targetBitRate              = 1000000;
SPI1.peripheral.$assign         = "SPI0";
SPI1.peripheral.sclkPin.$assign = "boosterpack.25";
SPI1.peripheral.mosiPin.$assign = "boosterpack.18";
SPI1.peripheral.misoPin.$assign = "boosterpack.23";
SPI1.peripheral.cs0Pin.$assign  = "boosterpack.4";
SPI1.sclkPinConfig.$name        = "ti_driverlib_gpio_GPIOPinGeneric6";
SPI1.mosiPinConfig.$name        = "ti_driverlib_gpio_GPIOPinGeneric7";
SPI1.misoPinConfig.$name        = "ti_driverlib_gpio_GPIOPinGeneric8";
SPI1.cs0PinConfig.$name         = "ti_driverlib_gpio_GPIOPinGeneric9";

SYSCTL.forceDefaultClkConfig = true;
SYSCTL.peripheral.$assign    = "SYSCTL";

TIMER1.$name              = "TIMER_0";
TIMER1.timerMode          = "ONE_SHOT_UP";
TIMER1.overrideRetention  = true;
TIMER1.interrupts         = ["LOAD"];
TIMER1.peripheral.$assign = "TIMG0";

TIMER2.$name              = "TIMER_1";
TIMER2.timerMode          = "ONE_SHOT_UP";
TIMER2.interrupts         = ["ZERO"];
TIMER2.timerClkPrescale   = 32;
TIMER2.timerPeriod        = "65 ms";
TIMER2.overrideRetention  = true;
TIMER2.peripheral.$assign = "TIMG7";

TIMER3.$name              = "TIMER_2";
TIMER3.timerMode          = "ONE_SHOT_UP";
TIMER3.interrupts         = ["LOAD"];
TIMER3.overrideRetention  = true;
TIMER3.peripheral.$assign = "TIMG6";

UART1.$name                    = "UART_0";
UART1.enabledInterrupts        = ["RX","RXD_NEG_EDGE","RXD_POS_EDGE","RX_TIMEOUT_ERROR","TX"];
UART1.targetBaudRate           = 115200;
UART1.enableFIFO               = true;
UART1.rxFifoThreshold          = "DL_UART_RX_FIFO_LEVEL_1_4_FULL";
UART1.txFifoThreshold          = "DL_UART_TX_FIFO_LEVEL_3_4_EMPTY";
UART1.peripheral.$assign       = "UART0";
UART1.peripheral.rxPin.$assign = "boosterpack.33";
UART1.peripheral.txPin.$assign = "boosterpack.34";
UART1.txPinConfig.$name        = "ti_driverlib_gpio_GPIOPinGeneric0";
UART1.rxPinConfig.$name        = "ti_driverlib_gpio_GPIOPinGeneric1";

UART2.targetBaudRate                   = 115200;
UART2.enableFIFO                       = true;
UART2.txFifoThreshold                  = "DL_UART_TX_FIFO_LEVEL_ONE_ENTRY";
UART2.enabledInterrupts                = ["EOT_DONE","RX","RXD_NEG_EDGE","RXD_POS_EDGE","RX_TIMEOUT_ERROR","TX"];
UART2.$name                            = "UART_3";
UART2.rxFifoThreshold                  = "DL_UART_RX_FIFO_LEVEL_1_4_FULL";
UART2.peripheral.$assign               = "UART3";
UART2.peripheral.rxPin.$assign         = "boosterpack.2";
UART2.peripheral.txPin.$assign         = "boosterpack.5";
UART2.txPinConfig.$name                = "ti_driverlib_gpio_GPIOPinGeneric10";
UART2.txPinConfig.direction            = scripting.forceWrite("OUTPUT");
UART2.txPinConfig.hideOutputInversion  = scripting.forceWrite(false);
UART2.txPinConfig.onlyInternalResistor = scripting.forceWrite(false);
UART2.txPinConfig.passedPeripheralType = scripting.forceWrite("Digital");
UART2.rxPinConfig.$name                = "ti_driverlib_gpio_GPIOPinGeneric11";
UART2.rxPinConfig.hideOutputInversion  = scripting.forceWrite(false);
UART2.rxPinConfig.onlyInternalResistor = scripting.forceWrite(false);
UART2.rxPinConfig.passedPeripheralType = scripting.forceWrite("Digital");

ProjectConfig.deviceSpin = "MSPM0G3507";

/**
 * Pinmux solution for unlocked pins/peripherals. This ensures that minor changes to the automatic solver in a future
 * version of the tool will not impact the pinmux you originally saw.  These lines can be completely deleted in order to
 * re-solve from scratch.
 */
GPIO6.associatedPins[0].pin.$suggestSolution = "j19_expansion.10";
GPIO6.associatedPins[1].pin.$suggestSolution = "j19_expansion.8";
GPIO6.associatedPins[2].pin.$suggestSolution = "j19_expansion.5";
